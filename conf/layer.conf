## conf/layer.conf
```bitbake
# We have a conf and classes directory, add to BBPATH
BBPATH .= ":${LAYERDIR}"

# We have recipes-* directories, add to BBFILES
BBFILES += "${LAYERDIR}/recipes-*/*/*.bb \
            ${LAYERDIR}/recipes-*/*/*.bbappend"

BBFILE_COLLECTIONS += "meta-ci4rail-devtools"
BBFILE_PATTERN_meta-ci4rail-devtools = "^${LAYERDIR}/"
BBFILE_PRIORITY_meta-ci4rail-devtools = "101"

LAYERDEPENDS_meta-ci4rail-devtools = "core "
LAYERSERIES_COMPAT_meta-ci4rail-devtools = "dunfell"
LAYERDEPENDS_meta-ci4rail-devtools = "meta-ci4rail-bsp"
```
